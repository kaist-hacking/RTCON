## CMakeLists.txt
```
# SPDX-License-Identifier: Apache-2.0

cmake_minimum_required(VERSION 3.20.0)
find_package(Zephyr REQUIRED HINTS $ENV{ZEPHYR_BASE})
project(Fuzzer)

if(DEFINED NATIVE)
    target_sources(app PRIVATE src/main_native.c)
endif()
if(DEFINED FUZZ)
    target_sources(app PRIVATE src/main.c)
    target_sources(app PRIVATE src/crash.c)
    target_sources(app PRIVATE src/fuzz.c)
    target_sources(app PRIVATE src/hashmap.c)
    target_sources(app PRIVATE src/hook.c)
endif()

zephyr_compile_options( -O0 -fno-inline -fno-builtin -g )
if(DEFINED ENV{CRASH_DIR_PATH})
    zephyr_compile_options( -DCRASH_DIR_PATH="$ENV{CRASH_DIR_PATH}" )
endif()
if(DEFINED ENV{LOW_FUZZ})
    zephyr_compile_options( -DLOW_FUZZ=1 )
endif()

if(DEFINED FUZZ)
    zephyr_compile_options( -fpass-plugin=/source/build/libcgcc.so )
    zephyr_compile_options( -fno-omit-frame-pointer -fsanitize-recover=address )
#    zephyr_compile_options( -DFUZZ_COVERAGE -fprofile-instr-generate -fcoverage-mapping )
    zephyr_compile_options( -DCOVERAGE_DIR_PATH="$ENV{COVERAGE_DIR_PATH}" )
    zephyr_compile_options( -DTEST_IDX=$ENV{TEST_IDX} )
    target_link_options(zephyr_interface INTERFACE -rdynamic -fprofile-instr-generate -fcoverage-mapping )
endif()
```

## Kconfig
```
# Copyright (c) 2017 Intel Corporation
# SPDX-License-Identifier: Apache-2.0

config ARCH_POSIX_FUZZ_IRQ
	int "OS interrupt via which to deliver fuzz cases"
	default 30
	help
	  In this sample, new fuzz cases are delivered to Zephyr
	  via interrupts.  The IRQ should be otherwise unused, but can
	  be any value desired by the app.

config ARCH_POSIX_FUZZ_TICKS
	int "Ticks to allow for fuzz case processing"
	default 2
	help
	  Fuzz interrupts are delivered, from the perspective of the
	  OS, at a steady cadence in simulated time.  In general most
	  apps won't require much time to reach an idle state
	  following a unit-test style case, so the default is short to
	  prevent interaction with regular timer workloads.

source "Kconfig.zephyr"
```

## prj.conf
```kconfig
CONFIG_ARCH_POSIX_LIBFUZZER=y
CONFIG_ASAN=y

CONFIG_NO_OPTIMIZATIONS=y

CONFIG_GNU_C_EXTENSIONS=y

CONFIG_BT=y
CONFIG_BT_PERIPHERAL=y
CONFIG_BT_GATT_CLIENT=y
CONFIG_BT_ASSERT=n

CONFIG_BT_CLASSIC=y
CONFIG_BT_AVDTP=y
CONFIG_BT_RFCOMM=y

CONFIG_BT_L2CAP_SEG_RECV=y

CONFIG_BT_SMP=y
CONFIG_BT_L2CAP_DYNAMIC_CHANNEL=y
CONFIG_BT_L2CAP_ECRED=y

CONFIG_ZCBOR=y
CONFIG_MCUMGR=y

CONFIG_BT_A2DP=y
CONFIG_BT_A2DP_SINK=y

CONFIG_BT_MESH=y
CONFIG_SETTINGS=y
CONFIG_BT_SETTINGS=y

CONFIG_BT_MESH_CDB=y
CONFIG_BT_MESH_PROVISIONER=y
CONFIG_BT_MESH_RPR_CLI=y

CONFIG_NETWORKING=y
CONFIG_MQTT_SN_LIB=y
CONFIG_NET_L2_ETHERNET=n

CONFIG_BT_AUDIO=y
CONFIG_BT_BAP_BROADCAST_ASSISTANT=y
CONFIG_BT_BAP_SCAN_DELEGATOR=y

CONFIG_BT_OTS=y

CONFIG_BT_ATT_TX_COUNT=20
CONFIG_BT_TBS_CLIENT_TBS=y
CONFIG_UTF8=y

CONFIG_BT_BAP_UNICAST_CLIENT=y

CONFIG_BT_PER_ADV=y
CONFIG_BT_PER_ADV_RSP=y
CONFIG_BT_BROADCASTER=y

CONFIG_BT_OBSERVER=y
CONFIG_BT_ECC=y
CONFIG_BT_PER_ADV_SYNC=y
# CONFIG_BT_ISO_UNICAST=y
CONFIG_BT_ISO_PERIPHERAL=y
CONFIG_BT_ISO_BROADCASTER=y
CONFIG_BT_ISO_SYNC_RECEIVER=y
CONFIG_BT_DF=y
CONFIG_BT_DF_CONNECTIONLESS_CTE_RX=y
CONFIG_BT_DF_CONNECTION_CTE_RX=y
CONFIG_BT_DF_CONNECTION_CTE_REQ=y
CONFIG_BT_TRANSMIT_POWER_CONTROL=y
# CONFIG_BT_PATH_LOSS_MONITORING=y
CONFIG_BT_PER_ADV_SYNC_RSP=y
CONFIG_BT_PER_ADV_RSP=y
CONFIG_BT_OBSERVER=y
# New features
CONFIG_BT_PER_ADV_SYNC_TRANSFER_SENDER=y
CONFIG_BT_PER_ADV_SYNC_TRANSFER_RECEIVER=y

CONFIG_BT_HFP_HF=y

CONFIG_NET_IPV4=y
CONFIG_NET_IPV6=y
CONFIG_NET_IPV4_HDR_OPTIONS=y
CONFIG_NET_6LO=y

CONFIG_NET_SHELL=y

CONFIG_EC_HOST_CMD=y
CONFIG_EC_HOST_CMD_BACKEND_SIMULATOR=y

CONFIG_MCUMGR_MGMT_NOTIFICATION_HOOKS=y

CONFIG_NET_TCP=y

CONFIG_CAN=y
CONFIG_ISOTP=y

#CONFIG_HAS_SEMTECH_RADIO_DRIVERS=y
#CONFIG_SYSTEM_WORKQUEUE_STACK_SIZE=4096
# CONFIG_LORA=y

# LoRaWAN application layer
# CONFIG_LORAWAN=y
# CONFIG_LORAMAC_REGION_EU868=y
# CONFIG_LORAWAN_NVM_SETTINGS=y

# LoRaWAN services required for FUOTA
# CONFIG_LORAWAN_SERVICES=y
# CONFIG_HAS_SEMTECH_LORAMAC=y

# CONFIG_LORAWAN_APP_CLOCK_SYNC=y
# CONFIG_LORAWAN_REMOTE_MULTICAST=y

# CONFIG_LORAWAN_FRAG_TRANSPORT=y
# CONFIG_LORAWAN_APP_CLOCK_SYNC=y

CONFIG_COAP=y

CONFIG_IPC_SERVICE=y
# CONFIG_MBOX=y

CONFIG_BT_BAP_BROADCAST_SOURCE=y
CONFIG_BT_BAP_BROADCAST_SINK=y

CONFIG_BT_ASCS=y
CONFIG_BT_BAP_UNICAST_SERVER=y
CONFIG_BT_ATT_PREPARE_COUNT=3

CONFIG_BT_SHELL=n
CONFIG_BT_A2DP_SOURCE=y
CONFIG_BT_A2DP_SINK=y

CONFIG_BT_HAS_CLIENT=y
CONFIG_BT_HAS=y
CONFIG_BT_HAS_FEATURES_NOTIFIABLE=y

CONFIG_BT_GATT_READ_MULT_VAR_LEN=y
CONFIG_BT_MESH_CFG_CLI=y

CONFIG_BT_MESH_OP_AGG_SRV=y
CONFIG_BT_MESH_OP_AGG_CLI=y

CONFIG_BT_OTS_CLIENT=y
```

## prj.native.conf
```kconfig
CONFIG_NO_OPTIMIZATIONS=y

CONFIG_GNU_C_EXTENSIONS=y

CONFIG_BT=y
CONFIG_BT_PERIPHERAL=y
CONFIG_BT_GATT_CLIENT=y
CONFIG_BT_ASSERT=n

CONFIG_BT_CLASSIC=y
CONFIG_BT_AVDTP=y
CONFIG_BT_RFCOMM=y

CONFIG_BT_L2CAP_SEG_RECV=y

CONFIG_BT_SMP=y
CONFIG_BT_L2CAP_DYNAMIC_CHANNEL=y
CONFIG_BT_L2CAP_ECRED=y

CONFIG_ZCBOR=y
CONFIG_MCUMGR=y

CONFIG_BT_A2DP=y
CONFIG_BT_A2DP_SINK=y

CONFIG_BT_MESH=y
CONFIG_SETTINGS=y
CONFIG_BT_SETTINGS=y

CONFIG_BT_MESH_CDB=y
CONFIG_BT_MESH_PROVISIONER=y
CONFIG_BT_MESH_RPR_CLI=y

CONFIG_NETWORKING=y
CONFIG_MQTT_SN_LIB=y
CONFIG_NET_L2_ETHERNET=n

CONFIG_BT_AUDIO=y
CONFIG_BT_BAP_BROADCAST_ASSISTANT=y
CONFIG_BT_BAP_SCAN_DELEGATOR=y

CONFIG_BT_OTS=y

CONFIG_BT_ATT_TX_COUNT=20
CONFIG_BT_TBS_CLIENT_TBS=y
CONFIG_UTF8=y

CONFIG_BT_BAP_UNICAST_CLIENT=y

CONFIG_BT_PER_ADV=y
CONFIG_BT_PER_ADV_RSP=y
CONFIG_BT_BROADCASTER=y

CONFIG_BT_OBSERVER=y
CONFIG_BT_ECC=y
CONFIG_BT_PER_ADV_SYNC=y
# CONFIG_BT_ISO_UNICAST=y
CONFIG_BT_ISO_PERIPHERAL=y
CONFIG_BT_ISO_BROADCASTER=y
CONFIG_BT_ISO_SYNC_RECEIVER=y
CONFIG_BT_DF=y
CONFIG_BT_DF_CONNECTIONLESS_CTE_RX=y
CONFIG_BT_DF_CONNECTION_CTE_RX=y
CONFIG_BT_DF_CONNECTION_CTE_REQ=y
CONFIG_BT_TRANSMIT_POWER_CONTROL=y
# CONFIG_BT_PATH_LOSS_MONITORING=y
CONFIG_BT_PER_ADV_SYNC_RSP=y
CONFIG_BT_PER_ADV_RSP=y
CONFIG_BT_OBSERVER=y
# New features
CONFIG_BT_PER_ADV_SYNC_TRANSFER_SENDER=y
CONFIG_BT_PER_ADV_SYNC_TRANSFER_RECEIVER=y

CONFIG_BT_HFP_HF=y

CONFIG_NET_IPV4=y
CONFIG_NET_IPV6=y
CONFIG_NET_IPV4_HDR_OPTIONS=y
CONFIG_NET_6LO=y

CONFIG_NET_SHELL=y

CONFIG_EC_HOST_CMD=y
CONFIG_EC_HOST_CMD_BACKEND_SIMULATOR=y

CONFIG_MCUMGR_MGMT_NOTIFICATION_HOOKS=y

CONFIG_NET_TCP=y

CONFIG_CAN=y
CONFIG_ISOTP=y

#CONFIG_HAS_SEMTECH_RADIO_DRIVERS=y
#CONFIG_SYSTEM_WORKQUEUE_STACK_SIZE=4096
CONFIG_LORA=y

# LoRaWAN application layer
CONFIG_LORAWAN=y
CONFIG_LORAMAC_REGION_EU868=y
CONFIG_LORAWAN_NVM_SETTINGS=y

# LoRaWAN services required for FUOTA
CONFIG_LORAWAN_SERVICES=y
CONFIG_HAS_SEMTECH_LORAMAC=y

CONFIG_LORAWAN_APP_CLOCK_SYNC=y
CONFIG_LORAWAN_REMOTE_MULTICAST=y

CONFIG_LORAWAN_FRAG_TRANSPORT=y
CONFIG_LORAWAN_APP_CLOCK_SYNC=y

CONFIG_COAP=y

CONFIG_IPC_SERVICE=y
CONFIG_MBOX=y

CONFIG_BT_BAP_BROADCAST_SOURCE=y
CONFIG_BT_BAP_BROADCAST_SINK=y

CONFIG_BT_ASCS=y
CONFIG_BT_BAP_UNICAST_SERVER=y
CONFIG_BT_ATT_PREPARE_COUNT=3

CONFIG_BT_SHELL=n
CONFIG_BT_A2DP_SOURCE=y
CONFIG_BT_A2DP_SINK=y

CONFIG_BT_HAS_CLIENT=y
CONFIG_BT_HAS=y
CONFIG_BT_HAS_FEATURES_NOTIFIABLE=y

CONFIG_BT_GATT_READ_MULT_VAR_LEN=y
CONFIG_BT_MESH_CFG_CLI=y

CONFIG_BT_MESH_OP_AGG_SRV=y
CONFIG_BT_MESH_OP_AGG_CLI=y

CONFIG_BT_OTS_CLIENT=y
```

## src/main.c
```c
#include <errno.h>
#include <stdarg.h>
#include <stdbool.h>
#include <stdio.h>
#include <stdlib.h>
#include <string.h>
#include <time.h>
#include <unistd.h>
#include <signal.h>
#include <setjmp.h>

#include "crash.h"
#include "fuzz.h"

#include <zephyr/net/buf.h>

/*-----------------------------------------------------------*/

static sigjmp_buf main_jump_buffer;
static struct sigaction default_sa;

/* Basic signal handler */
void ground_signal_handler(int signum, siginfo_t *info, void *context) {
  siglongjmp(main_jump_buffer, 2);
}

/*-----------------------------------------------------------*/

extern void resetHookCounter(void);
extern void registerNeverFree(void *);
extern void clearNeverFree(void);

/*-----------------------------------------------------------*/

/* TODO: They would be changed by test_selector.py. It is not good design*/

/*-----------------------------------------------------------*/

extern void fuzzEntryFunction(__uint8_t *Data, size_t Size);
void testNetBufSimple(__uint8_t *Data, size_t Size) {
  struct net_buf_simple buf;
  buf.data = Data;
  buf.__buf = Data;
  buf.size = Size;
  buf.len = Size;
  fuzzEntryFunction(&buf, Size);
}

void testNetBuf(__uint8_t *Data, size_t Size) {
  // For metadata
  char data[1024];
  struct net_buf *buf = (struct net_buf *)data;
  buf->data = Data;
  buf->__buf = Data;
  buf->size = Size;
  buf->len = Size;
  fuzzEntryFunction(buf, Size);
}

/*-----------------------------------------------------------*/

#if (TEST_IDX == 0)

static void fuzzEntryFunctionHelper(__uint8_t *Data, size_t Size) {
  testRawData(Data, Size);
}

#elif (TEST_IDX == 1)

static void fuzzEntryFunctionHelper(__uint8_t *Data, size_t Size) {
  testNetBuf(Data, Size);
}

/* TODO */
/* Optional Param Checks */
bool checkParamValid(void **param, int lengthIndex) {

  /* First check the validity */  
  struct net_buf *buf = *(struct net_buf **)param;
  if (buf->len > 2048)
    return false;

  /* Type is different */
  if (lengthIndex != -1) {
    return false;
  }

  return true;
}

/* TODO */
/* Change input type net_buf to other test type */
bool checkCrossValid(void **input, int input_index, uint64_t *length, int length_index) {
  if (length_index != -1) {
    struct net_buf *buf = *(struct net_buf **)input;
    uint8_t *data = buf->data;
    *(uint8_t **)input = data;
  }
  return true;
}

#elif (TEST_IDX == 2)

static void fuzzEntryFunctionHelper(__uint8_t *Data, size_t Size) {
  testNetBufSimple(Data, Size);
}

/* TODO */
bool checkParamValid(void **param, int lengthIndex) {
  struct net_buf_simple *buf = *(struct net_buf **)param;
  if (buf->len > 2048)
    return false;
  
  if (lengthIndex != -1) {
    return false;
  }

  return true;
}

/* TODO */
/* Change input type net_buf to other test type */
bool checkCrossValid(void **input, int input_index, uint64_t *length, int length_index) {
  if (length_index != -1) {
    struct net_buf_simple *buf = *(struct net_buf_simple **)input;
    uint8_t *data = buf->data;
    *(uint8_t **)input = data;
  }
  return true;
}

#endif

/*-----------------------------------------------------------*/

#ifdef FUZZ_COVERAGE
#include <pthread.h>
#include <stdio.h>
#include <sys/stat.h>

#define COVERAGE_INTERVAL (30 * 60)
#define COVERAGE_UPDATE_INTERVAL 60

#ifndef COVERAGE_DIR_PATH
#define COVERAGE_DIR_PATH "coverage_dir"
#endif

#define FLUSH_INTERVAL 5000
uint32_t iteration = 0;

extern int __llvm_profile_write_file(void);
extern void __llvm_profile_set_filename(char *);
__attribute__((no_sanitize("coverage"), no_sanitize("address"))) void
periodic_coverage_flush(void) {
  if ((iteration++ % FLUSH_INTERVAL) == 0) {
    /* Set coverage file name */
    char coverage_temp_file_name[256];
    char coverage_file_name[256];
    snprintf(coverage_temp_file_name, 256, "%s/%ld.profraw.tmp", COVERAGE_DIR_PATH,
             time(NULL) / COVERAGE_INTERVAL);
    snprintf(coverage_file_name, 256, "%s/%ld.profraw", COVERAGE_DIR_PATH,
             time(NULL) / COVERAGE_INTERVAL);
    __llvm_profile_set_filename(coverage_temp_file_name);

    __llvm_profile_write_file();

    /* If new coverage temp file is bigger than the previous one, update it */
    if (access(coverage_temp_file_name, F_OK) != -1) {
      if (access(coverage_file_name, F_OK) != -1) {
        struct stat st_prev, st_new;
        stat(coverage_file_name, &st_prev);
        stat(coverage_temp_file_name, &st_new);

        if (st_new.st_size >= st_prev.st_size) {
          rename(coverage_temp_file_name, coverage_file_name);
        } else {
          unlink(coverage_temp_file_name);
        }
      } else {
        rename(coverage_temp_file_name, coverage_file_name);
      }
    }
  }
}
#endif

/*-----------------------------------------------------------*/
__attribute__((no_sanitize("coverage"), no_sanitize("address"))) int
LLVMFuzzerTestOneInput(const __uint8_t *Data, size_t Size) {

#ifdef FUZZ_COVERAGE
  periodic_coverage_flush();
#endif

  register_asan_report_cb();

  MAIN_TRY {
    size_t fuzz_size = validateInput(Data, Size);

    if (fuzz_size) {
      // Reset hook counter
      resetHookCounter();

      // Free previously allocated memory
      clearNeverFree();

      __uint8_t *data = (__uint8_t *)malloc(fuzz_size);
      if (data) {
        registerNeverFree(data);

        memset(data, 0, fuzz_size);
        memcpy(data, Data, fuzz_size);

        fuzzEntryFunctionHelper(data, fuzz_size);
      }
    }
  }
  MAIN_CATCH {
    // Do nothing
  }
  MAIN_END_TRY;

  return 0;
}
```

## src/main_cov.c
```c
#include <errno.h>
#include <stdarg.h>
#include <stdbool.h>
#include <stdio.h>
#include <stdlib.h>
#include <string.h>
#include <time.h>
#include <unistd.h>
#include <signal.h>
#include <setjmp.h>

#include "crash.h"
#include "fuzz.h"

#include <zephyr/net/buf.h>

/*-----------------------------------------------------------*/

static sigjmp_buf main_jump_buffer;
static struct sigaction default_sa;

/* Basic signal handler */
void ground_signal_handler(int signum, siginfo_t *info, void *context) {
  siglongjmp(main_jump_buffer, 2);
}

/*-----------------------------------------------------------*/

extern void resetHookCounter(void);
extern void registerNeverFree(void *);
extern void clearNeverFree(void);

extern void fuzzEntryFunction(__uint8_t *Data, size_t Size);
void testNetBufSimple(__uint8_t *Data, size_t Size) {
  struct net_buf_simple buf;
  buf.data = Data;
  buf.__buf = Data;
  buf.size = Size;
  buf.len = Size;
  fuzzEntryFunction(&buf, Size);
}

void testNetBuf(__uint8_t *Data, size_t Size) {
  struct net_buf buf;
  buf.data = Data;
  buf.len = Size;
  fuzzEntryFunction(&buf, Size);
}

/*-----------------------------------------------------------*/

static void fuzzEntryFunctionHelper(__uint8_t *Data, size_t Size) {
  testRawData(Data, Size);
  // testNetBuf(Data, Size);
}

extern int _native_argc;
extern char **_native_argv;
__attribute__((no_sanitize("address"))) int main(int argc, char *argv[]) {
  if (_native_argc < 2) {
    printf("Usage: %s <filename>\n", _native_argv[0]);
    exit(1);
  }

  const char *filename = _native_argv[1];
  FILE *file = fopen(filename, "rb");
  if (file == NULL) {
    printf("Failed to open file: %s\n", filename);
    exit(1);
  }

  fseek(file, 0, SEEK_END);
  long size = ftell(file);
  rewind(file);

  char *Data = (char *)malloc(size);
  if (Data == NULL) {
    printf("Failed to allocate memory\n");
    fclose(file);
    exit(1);
  }

  size_t bytesRead = fread(Data, 1, size, file);
  if (bytesRead != size) {
    printf("Failed to read file: %s\n", filename);
    free(Data);
    fclose(file);
    exit(1);
  }

  fclose(file);

  register_asan_report_cb();
  MAIN_TRY {
    size_t fuzz_size = validateInput(Data, size);

    if (fuzz_size) {
      // Reset hook counter
      resetHookCounter();

      // Free previously allocated memory
      clearNeverFree();

      __uint8_t *data = (__uint8_t *)malloc(fuzz_size);
      if (data) {
        registerNeverFree(data);

        memset(data, 0, fuzz_size);
        memcpy(data, Data, fuzz_size);

        fuzzEntryFunctionHelper(data, fuzz_size);
      }
    }

    free(Data);
  }
  MAIN_CATCH {
    // Do nothing
  }
  MAIN_END_TRY;

  exit(0);
}
```

## src/main_native.c
```c
/* It is needed to construct compile_commands.json */
int main(int argc, char **argv) {
    return 0;
}
```
